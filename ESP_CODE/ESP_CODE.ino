#include <Wire.h> // display
#include <Adafruit_GFX.h> // display
#include <Adafruit_SSD1306.h> // display
#include "DHT.h" // sensor
#include <WiFi.h>
#include <ESPAsyncWebServer.h>

const char* ssid = "iPhone de Malu";
const char* password = "male1306";

#define SCREEN_WIDTH 128
#define SCREEN_HEIGHT 64
#define DHTPIN 16
#define DHTTYPE DHT11
#define SCREEN_ADDRESS 0x3C  // endereço do display

const unsigned char termometro[] PROGMEM = {
  0x00, 0x00, 0x03, 0xc0, 0x00, 0x00, 0x00, 0x00, 0x07, 0xf0, 0x00, 0x00, 0x00, 0x00, 0x0f, 0xf0,
  0x00, 0x00, 0x00, 0x00, 0x1f, 0xf8, 0x00, 0x00, 0x00, 0x00, 0x1e, 0x78, 0x00, 0x00, 0x00, 0x00,
  0x3c, 0x3c, 0x00, 0x00, 0x00, 0x00, 0x38, 0x1c, 0x00, 0x00, 0x00, 0x00, 0x38, 0x1c, 0x00, 0x00,
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  0x1f, 0xf8, 0x00, 0x00, 0x00, 0x00, 0x0f, 0xf0, 0x00, 0x00, 0x00, 0x00, 0x03, 0xe0, 0x00, 0x00
};

Adafruit_SSD1306 display(SCREEN_WIDTH, SCREEN_HEIGHT); // objeto do display
DHT dht(DHTPIN, DHTTYPE); // objeto do sensor

AsyncWebServer server(80);

float temperature = 0.0;
float humidity = 0.0;

int period = 10000;
unsigned long lastTime = 0;

void setup() {
  Serial.begin(115200);

  WiFi.begin(ssid, password);

  while (WiFi.status() != WL_CONNECTED) {
    delay(500);
    Serial.println("Conectando ao WiFi...");
  }

  Serial.print("Conectado em: ");
  Serial.println(WiFi.localIP());

  if (!display.begin(SSD1306_SWITCHCAPVCC, SCREEN_ADDRESS)) {
    Serial.println("Erro ao inicializar display");
  }

  server.on("/", HTTP_GET, [](AsyncWebServerRequest* request) {
    String html = "<meta charset=UTF-8><meta content=25 http-equiv=refresh><meta content=\"width=device-width,initial-scale=1\"name=viewport><style>body{margin:0;padding:0;background-color:#121212;color:#fff;height:calc(var(--vh,1vh) * 100);display:flex;justify-content:center;align-items:center;font-size:1.8rem}.c{width:75%;max-width:400px;height:60%;max-height:500px;border:1px solid red;border-radius:8px;background-color:#202020;display:flex;flex-direction:column;justify-content:center}p{text-align:center}.i{width:100\%;height:100\%;display:flex;flex-direction:column;align-items:center}.i>div{height:50%;width:100%;display:flex;flex-direction:column;align-items:center;justify-content:center}.i>div:nth-child(1){border-bottom:1px solid red}i{font-size:3.5rem}</style><title>Sensores</title><div class=c><div class=i><div><p>Temperatura</p><i class=\"fa-solid fa-temperature-half\"></i><p>" + String(temperature) + "°C</div><div><p>Umidade</p><i class=\"fa-solid fa-droplet\"></i><p>" + String(humidity) + "%</div></div></div><script>let v=window.innerHeight*0.01;document.documentElement.style.setProperty(\"--vh\",`${v}px`);</script><script crossorigin=anonymous src=https://kit.fontawesome.com/85de8204c5.js></script>";
    request->send(200, "text/html", html);
  });

  server.begin();

  dht.begin();
}

void loop() {
  humidity = dht.readHumidity();
  temperature = dht.readTemperature();

  if (isnan(humidity) || isnan(temperature))
    return;

  display.clearDisplay();
  display.setTextSize(1);
  display.setTextColor(WHITE);
  display.setCursor(0, 0);

  display.println("Temperatura:");
  display.print(temperature);
  display.println(" C");

  display.println('\n');

  display.println("Umidade:");
  display.print(humidity);
  display.println("%");

  display.drawBitmap(80, 0, termometro, 48, 64, 1);

  display.display();  // função que passa tudo que foi feito para o display


  if (millis() - lastTime > period) {
    Serial.print("Temperatura:");
    Serial.print(temperature);
    Serial.println(" C");

    Serial.print("Umidade:");
    Serial.print(humidity);
    Serial.println("%");

    Serial.println();

    lastTime = millis();
  }
}